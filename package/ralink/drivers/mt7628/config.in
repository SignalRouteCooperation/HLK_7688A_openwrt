## package/ralink/drivers/mt7628/config.in
```kconfig
if PACKAGE_kmod-mt7628

config MT7628_RT_FIRST_CARD
	int
	default 7628

config RALINK_MT7628
	bool
	default y

config MT7628_MT_WIFI
	bool
	select MT7628_WIFI_BASIC_FUNC
	default y

config MT7628_MT_WIFI_PATH
		string
		depends on MT7628_MT_WIFI
		default "rlt_wifi"

menu "WiFi Generic Feature Options"

config MT7628_FIRST_IF_EEPROM_FLASH
	bool
	default y

config MT7628_RT_FIRST_CARD_EEPROM
		string
		default "flash"


config MT7628_SECOND_IF_EEPROM_FLASH
	bool
	default y

config MT7628_RT_SECOND_CARD_EEPROM
		string
		default "flash"
		
config MT7628_MULTI_INF_SUPPORT
		bool
		default n

config MT7628_WIFI_BASIC_FUNC
	bool "Basic Functions"
	select WIRELESS_EXT
	select WEXT_SPY
	select WEXT_PRIV
     
config CONFIG_RT_READ_MAC_FROM_MTD
	bool
	default y

### under of here is valid	 
config CONFIG_RT_WSC
	bool "WSC (WiFi Simple Config)"
	default y

config CONFIG_RT_WSC_V2
	bool "WSC V2(WiFi Simple Config Version 2.0)"
	default y

config CONFIG_RT_80211N_DRAFT3
	bool "802.11n Draft3"
	default y
    
config CONFIG_RT_80211W_PMF
	bool "PMF"
	default y

config CONFIG_MT7628_AP_LLTD
	bool "LLTD (Link Layer Topology Discovery Protocol)"
	default n

config CONFIG_MT7628_AP_DLS
	bool "802.11e DLS ((Direct-Link Setup) Support"
	default n

config CONFIG_RT_WAPI
	bool "WAPI Support"
	default n

#config MT7628_CARRIER_DETECTION_SUPPORT
#	bool "Carrier Detect"
#	default n

config CONFIG_RT_IGMP_SNOOP
	bool "IGMP snooping"
	default n

config CONFIG_RT_NETIF_BLOCK
	bool "NETIF Block"
	default n
	help
	Support Net interface block while Tx-Sw queue full

#config MT7628_RATE_ADAPTION
#	bool "New Rate Adaptation support"
#	default y

#config MT7628_NEW_RATE_ADAPT_SUPPORT
#	bool "Intelligent Rate Adaption"
#	default y

#config MT7628_AGS_SUPPORT
#	bool "Adaptive Group Switching"
#	default n
    
config CONFIG_MT7628_AP_IDS
	bool "IDS (Intrusion Detection System) Support"
	default n

config CONFIG_RA_NETWORK_WORKQUEUE_BH
	bool "Work Queue"
	default n

#config MT7628_WIFI_SKB_RECYCLE
#	bool "SKB Recycle(Linux)"
#	default n

#config MT7628_RTMP_FLASH_SUPPORT
#	bool "Flash Support"
#	default y

config CONFIG_MT7628_AP_LED
	bool "LED Support"
	default n

config CONFIG_RT_ATE
	bool "ATE/QA Support"
	default n

config CONFIG_RT_MEMORY_OPTIMIZATION
	bool "Memory Optimization"
	default n

#config MT7628_UAPSD
#	bool "UAPSD support"
#	default y

#
# Section for chip architectures
#
#config MT7628_MT_MAC
#	bool
#	default y

#
# Section for interfaces
#
config MT7628_RTMP_PCI_SUPPORT
	bool

config MT7628_RTMP_USB_SUPPORT
	bool

config MT7628_RTMP_RBUS_SUPPORT
	bool

endmenu

menu "WiFi Operation Modes"
#config MT7628_WIFI_MODE_AP
#		bool
#		default y

config MT7628_MT_AP_SUPPORT
	bool #"Ralink RT2860 802.11n AP support"
#	depends on NET_RADIO 
	select WIRELESS_EXT
	select WEXT_SPY
	select WEXT_PRIV
	default y

config CONFIG_MT7628_AP_WDS
	bool "WDS"
	depends on MT7628_MT_AP_SUPPORT

config CONFIG_MT7628_AP_MBSS
	bool "MBSS"
	depends on MT7628_MT_AP_SUPPORT
	default y

#config MT7628_NEW_MBSSID_MODE
#	bool "New MBSSID MODE"
#	depends on MT7628_MT_AP_SUPPORT && MT7628_WMBSS_SUPPORT
#	depends on RALINK_RT3883 || RALINK_RT3352 || RALINK_RT5350 || RALINK_RT6352 || RALINK_MT7620 || RALINK_MT7628
#	default y

#config MT7628_ENHANCE_NEW_MBSSID_MODE
#	bool "Enhanced MBSSID mode"
#	depends on MT7628_NEW_MBSSID_MODE
#	default y

config CONFIG_MT7628_AP_APCLI
	bool "AP-Client Support"
	depends on MT7628_MT_AP_SUPPORT

config CONFIG_MT7628_AP_MAC_REPEATER
	bool "MAC Repeater Support"
	depends on MT7628_MT_AP_SUPPORT
	depends on CONFIG_MT7628_AP_APCLI
	depends on RALINK_RT6352 || RALINK_MT7620 || RALINK_MT7603E || MT7628_MT_AP_SUPPORT
	default n

#config CONFIG_RT_DOT11R_FTCONFIG_RT_DOT11R_FT
#	bool "802.11r Fast BSS Transition"
#	depends on MT7628_MT_AP_SUPPORT

#config CONFIG_RT_DOT11K_RRM
#	bool "802.11k Radio Resource Management"
#	depends on MT7628_MT_AP_SUPPORT

#config CONFIG_MT7628_AP_LLTD
#	bool "LLTD (Link Layer Topology Discovery Protocol)"
#	depends on MT7628_MT_AP_SUPPORT

#config MT7628_COC_SUPPORT
#	bool "CoC Support"
#	depends on MT7628_MT_AP_SUPPORT
#	default n

#config MT7628_ RT2860V2_SNMP
#	bool "Net-SNMP Support"
#	depends on MT7628_MT_AP_SUPPORT

#config MT7628_MCAST_RATE_SPECIFIC
#	bool "User specific tx rate of mcast pkt"
#	depends on MT7628_MT_AP_SUPPORT

#config MT7628_EXT_BUILD_CHANNEL_LIST
#	bool "Extension Channel List"
#	depends on MT7628_MT_AP_SUPPORT

#config MT7628_AUTO_CH_SELECT_ENHANCE
#	bool "Auto Channel Selection Enhancement"
#	depends on MT7628_MT_AP_SUPPORT

config MT7628_JOYLINK_SUPPORT
	bool "JoyLink Support"
	default n

config MT7628_AUTOLINK_SSID_SUPPORT
	bool "Auto link ssid Support"
	default n
	
endmenu	

endif
```
